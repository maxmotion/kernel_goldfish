## drivers/vbox/Kconfig
```kconfig
#
# Vbox drivers
#

config VBOX_GUEST
	tristate "Virtualbox guest modules"
	default n
	help
	  The evtchn driver allows a userspace process to triger event
	  channels and to receive notification of an event channel
	  firing.
	  If in doubt, say yes.
	  
```
